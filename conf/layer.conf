## conf/layer.conf
```bitbake
# We have a conf and classes directory, add to BBPATH
BBPATH .= ":${LAYERDIR}"

# We have a packages directory, add to BBFILES
BBFILES += "${LAYERDIR}/recipes-*/*/*.bb \
            ${LAYERDIR}/recipes-*/*/*.bbappend"

BBFILE_PATTERN_sbc-bench = "^${LAYERDIR}/"
BBFILE_PRIORITY_sbc-bench = "6"

LAYERSERIES_COMPAT_sbc-bench = "warrior zeus dunfell gatesgarth"
```
